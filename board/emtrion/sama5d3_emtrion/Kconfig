## board/emtrion/sama5d3_emtrion/Kconfig
```kconfig
if TARGET_SAMA5D3_EMTRION

config SYS_BOARD
	default "sama5d3_emtrion"

config SYS_VENDOR
	default "emtrion"

config SYS_CONFIG_NAME
	default "sama5d3_emtrion"

endif
```

## configs/sama5d3_emtrion_mmc_defconfig
```kconfig
CONFIG_ARM=y
CONFIG_ARCH_AT91=y
CONFIG_SYS_TEXT_BASE=0x26f00000
CONFIG_TARGET_SAMA5D3_EMTRION=y
CONFIG_BOOTDELAY=3
CONFIG_USE_BOOTARGS=y
CONFIG_ENV_IS_IN_FAT=y
CONFIG_DEFAULT_DEVICE_TREE="sbc-sama5d36"
CONFIG_ENV_VARS_UBOOT_CONFIG=y
CONFIG_SD_BOOT=y
CONFIG_BOOTARGS="console=ttyS0,115200 earlyprintk root=/dev/mmcblk0p2 rw rootwait"
# CONFIG_DISPLAY_BOARDINFO is not set
# CONFIG_MTDIDS_DEFAULT="nand0=atmel_nand"
# CONFIG_MTDPARTS_DEFAULT="mtdparts=atmel_nand:256k@0(bootstrap),512k@256k(uboot),256k@768k(env),511m@1m(rootfs)"
CONFIG_SPL_MMC_SUPPORT=y
CONFIG_SPL_GPIO_SUPPORT=y
CONFIG_SPL_LIBCOMMON_SUPPORT=y
CONFIG_SPL_LIBGENERIC_SUPPORT=y
CONFIG_SPL_FAT_SUPPORT=y
CONFIG_SPL_LIBDISK_SUPPORT=y
CONFIG_SPL_SERIAL_SUPPORT=y
CONFIG_SPL_DRIVERS_MISC_SUPPORT=y
CONFIG_SPL_CLK=y
CONFIG_SPL_TIMER=y
CONFIG_SPL_PINCTRL=y
CONFIG_SPL_FRAMEWORK=y
CONFIG_SPL_I2C_SUPPORT=y
CONFIG_SPL_SEPARATE_BSS=y
CONFIG_SPL=y
CONFIG_CMD_BOOTZ=y
CONFIG_CMD_MMC=y
CONFIG_CMD_NAND=y
CONFIG_CMD_NAND_TRIMFFS=y
CONFIG_CMD_USB=y
CONFIG_CMD_DHCP=y
CONFIG_CMD_MII=y
CONFIG_CMD_PING=y
CONFIG_CMD_EXT4=y
CONFIG_CMD_EXT4_WRITE=y
CONFIG_CMD_FAT=y
CONFIG_CMD_UBI=y
CONFIG_CMD_GPIO=y
CONFIG_CMD_I2C=y
CONFIG_CMD_SF=y
# CONFIG_CMD_FLASH is not set
# CONFIG_CMD_LOADS is not set
CONFIG_ATMEL_USART=y
CONFIG_ATMEL_PIT_TIMER=y
CONFIG_ATMEL_SPI=y
CONFIG_GENERIC_ATMEL_MCI=y
CONFIG_AT91_GPIO=y
CONFIG_MACB=y
CONFIG_FAT_WRITE=y
CONFIG_BOARD_EARLY_INIT_F=y
CONFIG_DISPLAY_CPUINFO=y
CONFIG_OF_BOARD_SETUP=y
CONFIG_SYS_I2C_AT91 is not set
CONFIG_SYS_MALLOC_F_LEN=0x400000
CONFIG_MTD=y
CONFIG_DEBUG_UART_BOARD_INIT=y
CONFIG_DEBUG_UART_BASE=0xffffee00
CONFIG_DEBUG_UART_CLOCK=132000000
CONFIG_DEBUG_UART_ATMEL=y
CONFIG_DEBUG_UART_ANNOUNCE=y
CONFIG_DEBUG_UART=y
CONFIG_HUSH_PARSER=y
CONFIG_CLK=y
CONFIG_CLK_AT91=y
CONFIG_AT91_UTMI=y
CONFIG_AT91_H32MX=y
CONFIG_PINCTRL=y
CONFIG_PINCTRL_AT91=y
CONFIG_TIMER=y
CONFIG_USB=y
CONFIG_USB_STORAGE=y
CONFIG_USB_EHCI_HCD=y
CONFIG_FIT=y
# CONFIG_DISPLAY_BOARDINFO is not set
CONFIG_OF_CONTROL=y
CONFIG_SPL_OF_CONTROL=y
CONFIG_OF_SPL_REMOVE_PROPS="interrupts interrupt-parent dmas dma-names"
CONFIG_DM=y
CONFIG_SPL_DM=y
CONFIG_SPL_DM_SEQ_ALIAS=y
CONFIG_DM_MMC=y
CONFIG_DM_ETH=y
CONFIG_DM_SERIAL=y
CONFIG_DM_USB=y
# CONFIG_W1 is not set
# CONFIG_W1_GPIO is not set
# CONFIG_W1_EEPROM is not set
# CONFIG_W1_EEPROM_DS24XXX is not set
CONFIG_OF_LIBFDT=y
CONFIG_OF_LIBFDT_OVERLAY=y
CONFIG_DM_GPIO=y
```
